## config/boards/shields/dactyl_manuform_5x6/Kconfig.defconfig
```kconfig
if SHIELD_DACTYL_MANUFORM_5x6_LEFT

    config ZMK_KEYBOARD_NAME
        default "DM-5x6(Left)"

    config ZMK_SPLIT_BLE_ROLE_CENTRAL
        default y

endif

if SHIELD_DACTYL_MANUFORM_5x6_RIGHT

    config ZMK_KEYBOARD_NAME
        default "DM-5x6(Right)"

endif

if SHIELD_DACTYL_MANUFORM_5x6_LEFT || SHIELD_DACTYL_MANUFORM_5x6_RIGHT

    config ZMK_SPLIT
        default y

endif
```

## config/boards/shields/dactyl_manuform_5x6/Kconfig.shield
```kconfig
config SHIELD_DACTYL_MANUFORM_5x6_LEFT
    def_bool $(shields_list_contains,dactyl_manuform_5x6_left)

config SHIELD_DACTYL_MANUFORM_5x6_RIGHT
    def_bool $(shields_list_contains,dactyl_manuform_5x6_right)
```

## config/boards/shields/skeletyl/Kconfig.shield
```kconfig
config SHIELD_SKELETYL_LEFT
    def_bool $(shields_list_contains,skeletyl_left)

config SHIELD_SKELETYL_RIGHT
    def_bool $(shields_list_contains,skeletyl_right)
```
